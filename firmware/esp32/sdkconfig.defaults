## firmware/esp32/sdkconfig.defaults
```kconfig
# Project defaults intentionally stay small.
# Do not enable Bluetooth here until the bridge needs it.
CONFIG_ESP_MAIN_TASK_STACK_SIZE=4096
CONFIG_ESPTOOLPY_FLASHSIZE_2MB=y
CONFIG_ESPTOOLPY_FLASHSIZE="2MB"
```
